## main/Kconfig.projbuild
```kconfig
menu "ClaudePanel remote link"

    config CC_REMOTE_LINK
        bool "Compile in the SSH remote link (Wi-Fi + libssh2)"
        default y
        help
            The display can dial out to an SSH server and accept bridges
            through a remote port forward (FIRMWARE.md §8 v1.4). Nothing
            runs until the bridge provisions it over USB; until then the
            firmware behaves exactly like a USB-only build. Turn this off
            to drop Wi-Fi and libssh2 from the image entirely.

    config CC_SSH_TASK_STACK
        int "SSH task stack size (bytes)"
        depends on CC_REMOTE_LINK
        range 8192 131072
        default 16384
        help
            Measured on hardware (N16R8, mbedTLS 4 / PSA, 2026-11-09): the
            handshake + auth + forward_listen path left 45544 of 49152 bytes
            untouched, i.e. < 4 KB used. The pong/reply path that runs on
            this task adds ~4 KB. 16 KB is a 2x margin; the firmware logs
            the high-water mark while clients are connected.

    config CC_SSH_RECONNECT_MS
        int "Reconnect delay after a failed or dropped session (ms)"
        depends on CC_REMOTE_LINK
        default 5000

    config CC_SSH_TRACE
        bool "Enable libssh2 trace logging"
        depends on CC_REMOTE_LINK
        default n

endmenu
```
